## config/west.yml
```yaml
manifest:
  remotes:
    - name: alvaromuente
      url-base: https://github.com/alvaromuente
  projects:
    - name: zmk
      remote: alvaromuente
      revision: multi_peripheral
      import: app/west.yml
  self:
    path: config
```
